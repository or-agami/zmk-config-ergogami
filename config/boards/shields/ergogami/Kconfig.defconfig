## config/boards/shields/ergogami/Kconfig.defconfig
```kconfig
# Copyright (c) 2020 The ZMK Contributors
# SPDX-License-Identifier: MIT

if SHIELD_ERGOGAMI_LEFT

config ZMK_KEYBOARD_NAME
	default "Ergogami"

config ZMK_SPLIT_BLE_ROLE_CENTRAL
	default y

endif

if SHIELD_ERGOGAMI_LEFT || SHIELD_ERGOGAMI_RIGHT

config ZMK_SPLIT
	default y

endif
```

## config/boards/shields/ergogami/Kconfig.shield
```kconfig
# Copyright (c) 2020 The ZMK Contributors
# SPDX-License-Identifier: MIT

config SHIELD_ERGOGAMI_LEFT
	def_bool $(shields_list_contains,ergogami_left)

config SHIELD_ERGOGAMI_RIGHT
	def_bool $(shields_list_contains,ergogami_right)
```

## config/boards/shields/ergogami_v2/Kconfig.shield
```kconfig
# Copyright (c) 2020 The ZMK Contributors
# SPDX-License-Identifier: MIT

config SHIELD_ERGOGAMI_V2_LEFT
	def_bool $(shields_list_contains,ergogami_v2_left)

config SHIELD_ERGOGAMI_V2_RIGHT
	def_bool $(shields_list_contains,ergogami_v2_right)
```

## config/west.yml
```yaml
manifest:
  remotes:
    - name: or-agami
      url-base: https://github.com/or-agami
  projects:
    - name: zmk-config-ergogami
      remote: or-agami
      revision: main
      import: app/west.yml
  self:
    path: config
```
